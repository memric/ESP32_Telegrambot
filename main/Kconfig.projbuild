## main/Kconfig.projbuild
```kconfig
# put here your custom config value
menu "Project Configuration"
config ESP_WIFI_SSID
    string "WiFi SSID"
    default "myssid"
    help
	SSID (network name) for the example to connect to.

config ESP_WIFI_PASSWORD
    string "WiFi Password"
    default "mypassword"
    help
	WiFi password (WPA or WPA2) for the example to use.
	
config TG_BOT_TOKEN
    string "Telegram Bot Token"
    default "token"
    help
	Telegram Bot Token.
endmenu
```
